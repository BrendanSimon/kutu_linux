/ {
	fpga_axi: fpga-axi@0 {
		compatible = "simple-bus";
		#address-cells = <0x1>;
		#size-cells = <0x1>;
		ranges;


		axi4_IND_controller_0: axi4_IND_controller@43c00000 {
			compatible = "kutu,axi4-IND-controller-1.00-a";
		   reg = <0x43c00000 0x10000>;
			#clock-cells = <0>;
			clocks = <&clkc 16>;
		   interrupt-parent = <&gic>;
			interrupts = <0 59 4>;
		   xlnx,dphase-timeout = <0x8>;
			xlnx,s-axi-min-size = <0x00003FFF>;
		   xlnx,slv-awidth = <0x20>;
		   xlnx,slv-dwidth = <0x20>;
			xlnx,sys-addr-width = <0xe>;
		   xlnx,use-wstrb = <0x0>;
	   } ;
	};

      uart_2: uartlite_0@42C00000 {
            compatible = "xlnx,xps-uartlite-1.00.a";
            reg = <0x42c00000 0x10000>;
            interrupt-parent = <&gic>;
            interrupts = <0 58 4>;
            clock = <100000000>;
        };
};
