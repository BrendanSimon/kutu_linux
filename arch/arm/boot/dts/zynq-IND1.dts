/dts-v1/;

// Gen 1 system uses ZedBoard controller.
/include/ "zynq-zed.dtsi"

// Include common setup for all IND systems (TBD).
// /include/ "zynq-IND.dtsi"

// Gen 1 system specific features (TBD: currently includes common features).
/include/ "zynq-IND1.dtsi"

